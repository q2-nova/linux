## arch/mips/configs/shanling_q2_defconfig
```kconfig
CONFIG_SYSVIPC=y
CONFIG_NO_HZ_IDLE=y
CONFIG_HIGH_RES_TIMERS=y
CONFIG_PREEMPT=y
CONFIG_IKCONFIG=y
CONFIG_IKCONFIG_PROC=y
CONFIG_LOG_BUF_SHIFT=15
CONFIG_BLK_DEV_INITRD=y
CONFIG_CC_OPTIMIZE_FOR_SIZE=y
CONFIG_KALLSYMS_ALL=y
CONFIG_EXPERT=y
CONFIG_MACH_INGENIC_SOC=y
CONFIG_X2000_SHANLING_Q2=y
CONFIG_CPU_MIPS32_R5=y
CONFIG_SMP=y
CONFIG_NR_CPUS=2
CONFIG_HOTPLUG_CPU=y
CONFIG_HZ_100=y
# CONFIG_SECCOMP is not set
CONFIG_MODULES=y
CONFIG_MODULE_UNLOAD=y
CONFIG_NET=y
CONFIG_PACKET=y
CONFIG_UNIX=y
CONFIG_INET=y
CONFIG_CFG80211=y
CONFIG_DEVTMPFS=y
CONFIG_DEVTMPFS_MOUNT=y
CONFIG_SERIAL_8250=y
CONFIG_SERIAL_8250_CONSOLE=y
CONFIG_SERIAL_8250_NR_UARTS=10
CONFIG_SERIAL_8250_RUNTIME_UARTS=10
CONFIG_SERIAL_8250_INGENIC=y
CONFIG_GPIO_SYSFS=y
# CONFIG_INGENIC_TIMER is not set
# CONFIG_INGENIC_SYSOST is not set
# CONFIG_INGENIC_OST is not set
CONFIG_TMPFS=y
CONFIG_PRINTK_TIME=y
CONFIG_CONSOLE_LOGLEVEL_DEFAULT=15
CONFIG_MAGIC_SYSRQ=y
CONFIG_DEBUG_FS=y
CONFIG_PANIC_TIMEOUT=10
CONFIG_STACKTRACE=y
CONFIG_I2C=y
CONFIG_I2C_CHARDEV=y
CONFIG_I2C_JZ4780=y
CONFIG_INPUT_EVDEV=y
CONFIG_KEYBOARD_GPIO=y
CONFIG_POWER_SUPPLY=y
CONFIG_BATTERY_CW2015=y
CONFIG_REGULATOR=y
CONFIG_REGULATOR_FIXED_VOLTAGE=y
CONFIG_MMC=y
CONFIG_PWRSEQ_Q2=y
CONFIG_MMC_BLOCK=y
CONFIG_MMC_SDHCI=y
CONFIG_MMC_SDHCI_PLTFM=y
CONFIG_MMC_SDHCI_INGENIC=y
CONFIG_SPI=y
CONFIG_SPI_INGENIC_SFC=y
CONFIG_MTD=y
CONFIG_MTD_BLOCK=y
CONFIG_MTD_CMDLINE_PARTS=y
CONFIG_MTD_SPI_NAND=y
CONFIG_SQUASHFS=y
CONFIG_SQUASHFS_XZ=y
CONFIG_SQUASHFS_ZSTD=y
CONFIG_I2C_GPIO=y
CONFIG_MFD_AXP20X_I2C=y
CONFIG_REGULATOR_AXP20X=y
CONFIG_AXP20X_POWER=y
CONFIG_BATTERY_AXP20X=y
CONFIG_IIO=y
CONFIG_AXP20X_ADC=y
CONFIG_PWM=y
CONFIG_PWM_INGENIC_X2000=y
CONFIG_BACKLIGHT_CLASS_DEVICE=y
CONFIG_BACKLIGHT_PWM=y
CONFIG_LOCALVERSION="-q2"
# CONFIG_LOCALVERSION_AUTO is not set
# CONFIG_INITRAMFS_PRESERVE_MTIME is not set
CONFIG_DRM=y
CONFIG_DRM_INGENIC_X2000=y
CONFIG_DRM_PANEL_SHANLING_Q2=y
CONFIG_DRM_FBDEV_EMULATION=y
CONFIG_DRM_CLIENT_SELECTION=y
CONFIG_DRM_CLIENT_DEFAULT_FBDEV=y
CONFIG_SOUND=y
CONFIG_SND=y
CONFIG_SND_SOC=y
CONFIG_SND_SOC_SHANLING_Q2=y
CONFIG_HIGH_RES_TIMERS=y
CONFIG_PM=y
CONFIG_SUSPEND=y
CONFIG_SUSPEND_FREEZER=y
CONFIG_PM_DEBUG=y
CONFIG_PM_SLEEP_DEBUG=y
CONFIG_PM_ADVANCED_DEBUG=y
CONFIG_LTO_NONE=y
# CONFIG_LTO_CLANG is not set
# CONFIG_LTO_CLANG_THIN is not set
CONFIG_RESET_CONTROLLER=y
CONFIG_WATCHDOG=y
CONFIG_WATCHDOG_SYSFS=y
CONFIG_INGENIC_X2000_WDT=y
# CONFIG_WATCHDOG_HANDLE_BOOT_ENABLED is not set
CONFIG_INPUT_MISC=y
CONFIG_INPUT_PWM_BEEPER=m
CONFIG_SND_DRIVERS=y
CONFIG_SND_X2000_PWM_AUDIO=m
CONFIG_INPUT_SHANLING_Q2_WHEEL=y
CONFIG_RTC_CLASS=y
CONFIG_RTC_DRV_JZ4740=y

CONFIG_KEXEC=y
# CONFIG_CRASH_DUMP is not set

CONFIG_USB=y
CONFIG_USB_GADGET=y
CONFIG_USB_DWC2=y
CONFIG_USB_DWC2_PERIPHERAL=y
CONFIG_PHY_INGENIC_X2000_USB=y
CONFIG_CONFIGFS_FS=y
CONFIG_USB_CONFIGFS=y
CONFIG_USB_CONFIGFS_RNDIS=y
CONFIG_MIPS_CMDLINE_FROM_DTB=y
CONFIG_VFAT_FS=m
CONFIG_FAT_FS=m
CONFIG_FAT_DEFAULT_CODEPAGE=437
CONFIG_FAT_DEFAULT_IOCHARSET="iso8859-1"
CONFIG_PSTORE=y
CONFIG_PSTORE_RAM=y
CONFIG_PSTORE_CONSOLE=y
CONFIG_PSTORE_PMSG=y
CONFIG_PSTORE_COMPRESS=y
CONFIG_PSTORE_DEFAULT_KMSG_BYTES=10240
CONFIG_REED_SOLOMON=y
CONFIG_REED_SOLOMON_ENC8=y
CONFIG_REED_SOLOMON_DEC8=y

# Shared Q2 CPU/L2 scaling; qualify dynamic policies before changing the default.
CONFIG_PERF_EVENTS=y
CONFIG_CPU_FREQ=y
CONFIG_Q2_CPUFREQ=y
CONFIG_CPU_FREQ_DEFAULT_GOV_PERFORMANCE=y
CONFIG_CPU_FREQ_STAT=y
CONFIG_CPU_FREQ_GOV_PERFORMANCE=y
CONFIG_CPU_FREQ_GOV_POWERSAVE=y
CONFIG_CPU_FREQ_GOV_USERSPACE=y
CONFIG_CPU_FREQ_GOV_ONDEMAND=y
CONFIG_CPU_FREQ_GOV_CONSERVATIVE=y
CONFIG_CPU_FREQ_GOV_SCHEDUTIL=y
```

## arch/mips/ingenic/Kconfig
```kconfig
# SPDX-License-Identifier: GPL-2.0

config MACH_INGENIC_GENERIC
	bool
	select MACH_INGENIC
	select MACH_JZ4740
	select MACH_JZ4725B
	select MACH_JZ4770
	select MACH_JZ4780
	select MACH_X1000
	select MACH_X1830
	select MACH_X2000

choice
	prompt "Machine type"
	depends on MACH_INGENIC_SOC
	default INGENIC_GENERIC_BOARD

config INGENIC_GENERIC_BOARD
	bool "Generic board"
	select MACH_INGENIC_GENERIC

config JZ4740_QI_LB60
	bool "Qi Hardware Ben NanoNote"
	select MACH_JZ4740

config JZ4740_RS90
	bool "YLM RetroMini (RS-90)"
	select MACH_JZ4725B

config JZ4770_GCW0
	bool "Game Consoles Worldwide GCW Zero"
	select MACH_JZ4770

config JZ4780_CI20
	bool "MIPS Creator CI20"
	select MACH_JZ4780

config X1000_CU1000_NEO
	bool "YSH & ATIL CU1000 Module with Neo backplane"
	select MACH_X1000

config X1830_CU1830_NEO
	bool "YSH & ATIL CU1830 Module with Neo backplane"
	select MACH_X1830

config X2000_SHANLING_Q2
	bool "Shanling Q2 portable music player"
	select MACH_X2000

endchoice

config MACH_JZ4725B
	bool
	select SYS_HAS_CPU_MIPS32_R1

config MACH_JZ4740
	bool
	select SYS_HAS_CPU_MIPS32_R1

config MACH_JZ4770
	bool
	select MIPS_CPU_SCACHE
	select SYS_HAS_CPU_MIPS32_R2
	select SYS_SUPPORTS_HIGHMEM

config MACH_JZ4780
	bool
	select MIPS_CPU_SCACHE
	select SYS_HAS_CPU_MIPS32_R2
	select SYS_SUPPORTS_HIGHMEM

config MACH_X1000
	bool
	select MIPS_CPU_SCACHE
	select SYS_HAS_CPU_MIPS32_R2
	select SYS_SUPPORTS_HIGHMEM

config MACH_X1830
	bool
	select MIPS_CPU_SCACHE
	select SYS_HAS_CPU_MIPS32_R2
	select SYS_SUPPORTS_HIGHMEM

config MACH_X2000
	bool
	select GENERIC_CLOCKEVENTS_BROADCAST if SMP
	select SYS_HAS_CPU_MIPS32_R5
	select SYS_SUPPORTS_HIGHMEM
	select SYS_SUPPORTS_SMP
	select MIPS_O32_FP64_SUPPORT
	select WEAK_ORDERING
	select WEAK_REORDERING_BEYOND_LLSC

config INGENIC_X2000_SMP
	def_bool SMP && MACH_X2000 && !MIPS_CPS
	select SYS_SUPPORTS_HOTPLUG_CPU
	select GENERIC_IRQ_MIGRATION if HOTPLUG_CPU

config INGENIC_X2000_NORMAL_SLEEP
	bool "Q2 normal retained-CPU system sleep"
	depends on X2000_SHANLING_Q2 && SUSPEND && INGENIC_X2000_WDT=y
	help
	  Admit ordinary Linux mem suspend on the Q2 using the retained-CPU
	  SLEEP sequence. The ordinary watchdog device PM policy stops its
	  timer for indefinite sleep and restores the previous state on resume.
	  Only the public proof and entry policy are exposed. Leave disabled
	  for the journal/generation-bound diagnostic recovery profile.
```

## drivers/phy/ingenic/Kconfig
```kconfig
# SPDX-License-Identifier: GPL-2.0
#
# Phy drivers for Ingenic platforms
#
config PHY_INGENIC_USB
	tristate "Ingenic SoCs USB PHY Driver"
	depends on MIPS || COMPILE_TEST
	depends on USB_SUPPORT
	depends on HAS_IOMEM
	select GENERIC_PHY
	help
	  This driver provides USB PHY support for the USB controller found
	  on the JZ-series and X-series SoCs from Ingenic.

config PHY_INGENIC_X2000_USB
	tristate "Ingenic X2000 CPM/analog USB PHY"
	depends on MIPS || COMPILE_TEST
	depends on USB_SUPPORT && HAS_IOMEM
	select GENERIC_PHY
	help
	  Generic PHY API for the X2000 vendor CPM and analog register sequence.
	  Requires board power supplies to be enabled by firmware.
	  Controls both the CPM reset fields and the analog receiver bank.
	  Used with the DWC2 peripheral controller on the Shanling Q2.
```

## sound/soc/jz4740/Kconfig
```kconfig
# SPDX-License-Identifier: GPL-2.0-only
menu "Ingenic"

config SND_JZ4740_SOC_I2S
	tristate "SoC Audio (I2S protocol) for Ingenic JZ4740 SoC"
	depends on MIPS || COMPILE_TEST
	depends on HAS_IOMEM
	select REGMAP_MMIO
	select SND_SOC_GENERIC_DMAENGINE_PCM
	help
	  Say Y if you want to use I2S protocol and I2S codec on Ingenic JZ4740
	  based boards.

config SND_SOC_X2000
	tristate "Ingenic X2000 BAIC1 playback"
	depends on MIPS || COMPILE_TEST
	depends on HAS_IOMEM && COMMON_CLK
	help
	  Playback through audio DMA0, DSP timeslot 9 and BAIC1. Uses the
	  stock Q2 polling DMA protocol; capture and DMA interrupts are not
	  supported yet.

config SND_SOC_SHANLING_Q2
	tristate "Shanling Q2 sound card"
	depends on OF && I2C && GPIOLIB && RESET_CONTROLLER
	depends on (MIPS || COMPILE_TEST) && HAS_IOMEM && COMMON_CLK
	select SND_SOC_X2000
	select SND_SOC_CS43130
	select RESET_GPIO
	help
	  Q2 stereo PCM playback using BAIC1 and four CS43131 endpoints.
	  Physical output, supply mapping and high-gain operation require
	  hardware qualification. The initial integration is emulator-tested.

endmenu
```
