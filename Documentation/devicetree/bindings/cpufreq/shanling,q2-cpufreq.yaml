## Documentation/devicetree/bindings/cpufreq/shanling,q2-cpufreq.yaml
```yaml
# SPDX-License-Identifier: GPL-2.0-only OR BSD-2-Clause
%YAML 1.2
---
$id: http://devicetree.org/schemas/cpufreq/shanling,q2-cpufreq.yaml#
$schema: http://devicetree.org/meta-schemas/core.yaml#

title: Shanling Q2 shared CPU and L2 divider scaling

maintainers:
  - Nova <361320585+q2-nova@users.noreply.github.com>

description: |
  The X2000 logical CPUs share a CPU clock and coupled L2 divider. The Q2
  operates these from a fixed 1200 MHz parent and fixed core supply. This
  provider supports divider changes only, without changing PLLs or supplies.

properties:
  compatible:
    const: shanling,q2-cpufreq
  clocks:
    maxItems: 3
  clock-names:
    items:
      - const: cpu
      - const: l2
      - const: parent

required:
  - compatible
  - clocks
  - clock-names

additionalProperties: false
```

## Documentation/devicetree/bindings/display/ingenic,x2000-dpu.yaml
```yaml
# SPDX-License-Identifier: (GPL-2.0-only OR BSD-2-Clause)
%YAML 1.2
---
$id: http://devicetree.org/schemas/display/ingenic,x2000-dpu.yaml#
$schema: http://devicetree.org/meta-schemas/core.yaml#
title: Ingenic X2000 display processing unit
maintainers:
  - linux-mips@vger.kernel.org
properties:
  compatible:
    const: ingenic,x2000-dpu
  reg:
    maxItems: 1
  interrupts:
    maxItems: 1
  clocks:
    maxItems: 1
  clock-names:
    const: lcd
  port:
    $ref: /schemas/graph.yaml#/properties/port
    description: Pixel output to the DSI host.
required:
  - compatible
  - reg
  - interrupts
  - clocks
  - clock-names
  - port
additionalProperties: false
```

## Documentation/devicetree/bindings/display/ingenic,x2000-dsi.yaml
```yaml
# SPDX-License-Identifier: (GPL-2.0-only OR BSD-2-Clause)
%YAML 1.2
---
$id: http://devicetree.org/schemas/display/ingenic,x2000-dsi.yaml#
$schema: http://devicetree.org/meta-schemas/core.yaml#
title: Ingenic X2000 MIPI DSI host and PHY
maintainers:
  - linux-mips@vger.kernel.org
allOf:
  - $ref: dsi-controller.yaml#
properties:
  compatible:
    const: ingenic,x2000-dsi
  reg:
    items:
      - description: Synopsys DSI host registers
      - description: X2000 DSI PHY registers
  clocks:
    maxItems: 1
  clock-names:
    const: pclk
  ports:
    $ref: /schemas/graph.yaml#/properties/ports
    properties:
      port@0:
        $ref: /schemas/graph.yaml#/properties/port
        description: Pixel input from the DPU.
      port@1:
        $ref: /schemas/graph.yaml#/properties/port
        description: DSI output to the panel.
    required:
      - port@0
      - port@1
required:
  - compatible
  - reg
  - clocks
  - clock-names
  - ports
unevaluatedProperties: false
```

## Documentation/devicetree/bindings/display/panel/shanling,q2-h0209s.yaml
```yaml
# SPDX-License-Identifier: (GPL-2.0-only OR BSD-2-Clause)
%YAML 1.2
---
$id: http://devicetree.org/schemas/display/panel/shanling,q2-h0209s.yaml#
$schema: http://devicetree.org/meta-schemas/core.yaml#
title: Shanling Q2 H0209S 320x375 DSI panel
maintainers:
  - linux-mips@vger.kernel.org
allOf:
  - $ref: panel-common.yaml#
properties:
  compatible:
    const: shanling,q2-h0209s
  reg:
    maxItems: 1
  backlight: true
  port: true
  reset-gpios:
    maxItems: 1
  vdd28-supply:
    description: 2.8 V panel supply (Q2 AXP2101 ALDO2).
  vdd33-supply:
    description: 3.3 V panel supply (Q2 AXP2101 ALDO4).
required:
  - compatible
  - reg
  - backlight
  - port
  - reset-gpios
  - vdd28-supply
  - vdd33-supply
additionalProperties: false
```

## Documentation/devicetree/bindings/input/shanling,q2-touchscreen.yaml
```yaml
# SPDX-License-Identifier: (GPL-2.0-only OR BSD-2-Clause)
%YAML 1.2
---
$id: http://devicetree.org/schemas/input/shanling,q2-touchscreen.yaml#
$schema: http://devicetree.org/meta-schemas/core.yaml#

title: Shanling Q2 CST8xxT touchscreen application interface

maintainers:
  - Linux MIPS List <linux-mips@vger.kernel.org>

description: |
  The display panel is separate from the Q2 capacitive wheel. PA14 is the
  active-low controller reset and PA15 signals new reports on a falling edge.

properties:
  compatible:
    const: shanling,q2-touchscreen
  reg:
    const: 0x15
  interrupts:
    maxItems: 1
  reset-gpios:
    maxItems: 1
  vdd-supply:
    description: Dedicated 2.8 V analog supply from AXP2101 ALDO3.

required:
  - compatible
  - reg
  - interrupts
  - reset-gpios
  - vdd-supply

additionalProperties: false
```

## Documentation/devicetree/bindings/input/shanling,q2-wheel.yaml
```yaml
# SPDX-License-Identifier: (GPL-2.0-only OR BSD-2-Clause)
%YAML 1.2
---
$id: http://devicetree.org/schemas/input/shanling,q2-wheel.yaml#
$schema: http://devicetree.org/meta-schemas/core.yaml#

title: Shanling Q2 CST816T wheel firmware

maintainers:
  - linux-mips@vger.kernel.org

description: |
  The Q2 uses custom CST816T firmware with an absolute ring position at
  register 0x21 (1 through 200, zero means released). This is not the generic
  CST816T touchscreen coordinate protocol. PB20 resets the controller and
  PB21 signals a new report with a falling edge.

properties:
  compatible:
    const: shanling,q2-wheel
  reg:
    maxItems: 1
  interrupts:
    maxItems: 1
  reset-gpios:
    maxItems: 1

required:
  - compatible
  - reg
  - interrupts
  - reset-gpios

additionalProperties: false
```

## Documentation/devicetree/bindings/interrupt-controller/ingenic,x2000-intc.yaml
```yaml
# SPDX-License-Identifier: (GPL-2.0-only OR BSD-2-Clause)
%YAML 1.2
---
$id: http://devicetree.org/schemas/interrupt-controller/ingenic,x2000-intc.yaml#
$schema: http://devicetree.org/meta-schemas/core.yaml#

title: Ingenic X2000 interrupt and system-wake controllers

maintainers:
  - Paul Cercueil <paul@crapouillou.net>

description: |
  Per-core interrupt masks route 64 sources independently. A separate bank,
  clocked only for system sleep, selects the sources that can wake the SoC.

properties:
  compatible:
    const: ingenic,x2000-intc
  reg:
    items:
      - description: Per-core routing banks
      - description: System-wake bank
  reg-names:
    items:
      - const: core
      - const: wake
  clocks:
    maxItems: 1
  clock-names:
    const: wake
  interrupts:
    maxItems: 1
  interrupt-controller: true
  "#interrupt-cells":
    const: 1

required:
  - compatible
  - reg
  - reg-names
  - clocks
  - clock-names
  - interrupts
  - interrupt-controller
  - "#interrupt-cells"

additionalProperties: false
```

## Documentation/devicetree/bindings/mmc/shanling,q2-wifi-pwrseq.yaml
```yaml
# SPDX-License-Identifier: (GPL-2.0-only OR BSD-2-Clause)
%YAML 1.2
---
$id: http://devicetree.org/schemas/mmc/shanling,q2-wifi-pwrseq.yaml#
$schema: http://devicetree.org/meta-schemas/core.yaml#

title: Shanling Q2 Wi-Fi power prerequisites

maintainers:
  - linux-mips@vger.kernel.org

description: |
  The Q2 combo chip requires three AXP2101 rails before MSC1 enumeration.
  The rails are shared and retain the board's always-on constraints. This
  provider establishes supply readiness; the separate vmmc fixed-regulator
  chain owns BT_DIS_N, WL_DIS_N and their existing power-on delays. The rail
  names identify the observed PMIC outputs, not an inferred electrical topology.

properties:
  compatible:
    const: shanling,q2-wifi-pwrseq
  aldo1-supply: true
  bldo1-supply: true
  bldo2-supply: true

required:
  - compatible
  - aldo1-supply
  - bldo1-supply
  - bldo2-supply

additionalProperties: false

examples:
  - |
    wifi-pwrseq {
        compatible = "shanling,q2-wifi-pwrseq";
        aldo1-supply = <&aldo1>;
        bldo1-supply = <&bldo1>;
        bldo2-supply = <&bldo2>;
    };
```

## Documentation/devicetree/bindings/phy/ingenic,x2000-usb-phy.yaml
```yaml
# SPDX-License-Identifier: (GPL-2.0-only OR BSD-2-Clause)
%YAML 1.2
---
$id: http://devicetree.org/schemas/phy/ingenic,x2000-usb-phy.yaml#
$schema: http://devicetree.org/meta-schemas/core.yaml#

title: Ingenic X2000 CPM and analog USB PHY

maintainers:
  - Nova <361320585+q2-nova@users.noreply.github.com>

description: |
  Vendor-compatible X2000 PHY with CPM control and a separate analog register
  bank. Unlike ingenic,x2000-phy, this describes both register windows and the
  vendor reset sequence. Board supplies must already be enabled by firmware.
  This binding does not describe host VBUS switching or external VBUS detection.

properties:
  compatible:
    const: ingenic,usbphy-x2000

  reg:
    items:
      - description: CPM control registers shared with the clock provider
      - description: USB PHY analog registers

  clocks:
    maxItems: 1

  '#phy-cells':
    const: 0

required:
  - compatible
  - reg
  - clocks
  - '#phy-cells'

additionalProperties: false

examples:
  - |
    #include <dt-bindings/clock/ingenic,x2000-cgu.h>
    usb-phy@10000000 {
      compatible = "ingenic,usbphy-x2000";
      reg = <0x10000000 0x100>, <0x10078000 0x110>;
      clocks = <&cgu X2000_CLK_OTGPHY>;
      #phy-cells = <0>;
    };
```

## Documentation/devicetree/bindings/pwm/ingenic,x2000-pwm.yaml
```yaml
# SPDX-License-Identifier: (GPL-2.0-only OR BSD-2-Clause)
%YAML 1.2
---
$id: http://devicetree.org/schemas/pwm/ingenic,x2000-pwm.yaml#
$schema: http://devicetree.org/meta-schemas/core.yaml#

title: Ingenic X2000 standalone PWM controller

maintainers:
  - linux-mips@vger.kernel.org

description: |
  Sixteen PWM channels with individual power-of-two prescalers and 16-bit
  high/low counters. This block is separate from the older Ingenic TCU.

allOf:
  - $ref: pwm.yaml#

properties:
  compatible:
    const: ingenic,x2000-pwm

  reg:
    maxItems: 1

  clocks:
    maxItems: 1

  "#pwm-cells":
    const: 3

required:
  - compatible
  - reg
  - clocks
  - "#pwm-cells"

additionalProperties: false

examples:
  - |
    pwm@134c0000 {
        compatible = "ingenic,x2000-pwm";
        reg = <0x134c0000 0x400>;
        clocks = <&pwm_clk>;
        #pwm-cells = <3>;
    };
```

## Documentation/devicetree/bindings/sound/ingenic,x2000-audio.yaml
```yaml
# SPDX-License-Identifier: (GPL-2.0-only OR BSD-2-Clause)
%YAML 1.2
---
$id: http://devicetree.org/schemas/sound/ingenic,x2000-audio.yaml#
$schema: http://devicetree.org/meta-schemas/core.yaml#
title: Ingenic X2000 audio subsystem
maintainers:
  - linux-mips@vger.kernel.org
description: |
  Audio DMA, FIFOs, format conversion, DSP timeslot routing and BAIC ports.
  The initial driver supports stereo PCM through DMA0 and BAIC1 using the
  Q2 stock descriptor and pointer-polling protocol.
properties:
  compatible:
    const: ingenic,x2000-audio
  reg:
    maxItems: 1
  clocks:
    items:
      - description: Audio subsystem bus gate
      - description: BAIC1 serial clock with its gate
  clock-names:
    items:
      - const: audio
      - const: i2s1
  '#sound-dai-cells':
    const: 0
required:
  - compatible
  - reg
  - clocks
  - clock-names
  - '#sound-dai-cells'
additionalProperties: false
```

## Documentation/devicetree/bindings/sound/ingenic,x2000-pwm-audio.yaml
```yaml
# SPDX-License-Identifier: (GPL-2.0-only OR BSD-2-Clause)
%YAML 1.2
---
$id: http://devicetree.org/schemas/sound/ingenic,x2000-pwm-audio.yaml#
$schema: http://devicetree.org/meta-schemas/core.yaml#

title: PCM playback and tones through an Ingenic X2000 PWM channel

maintainers:
  - linux-mips@vger.kernel.org

description: |
  A buzzer or small speaker driven by one channel of the X2000 standalone
  PWM controller. The channel plays mono PCM with looping PWM DMA, and
  tones through an input device compatible with pwm-beeper.

properties:
  compatible:
    const: ingenic,x2000-pwm-audio

  pwms:
    maxItems: 1

  beeper-hz:
    description: Frequency of the SND_BELL tone.
    minimum: 10
    maximum: 10000
    default: 1000

required:
  - compatible
  - pwms

unevaluatedProperties: false

examples:
  - |
    clicker {
        compatible = "ingenic,x2000-pwm-audio";
        pwms = <&pwm 1 361794 0>;
        beeper-hz = <2764>;
    };
```

## Documentation/devicetree/bindings/sound/shanling,q2-audio.yaml
```yaml
# SPDX-License-Identifier: (GPL-2.0-only OR BSD-2-Clause)
%YAML 1.2
---
$id: http://devicetree.org/schemas/sound/shanling,q2-audio.yaml#
$schema: http://devicetree.org/meta-schemas/core.yaml#
title: Shanling Q2 audio topology
maintainers:
  - linux-mips@vger.kernel.org
description: |
  X2000 BAIC1 drives four CS43131 control endpoints. In the stock PCM
  configuration 0x30/31 copy left, 0x32/33 copy right, and B is inverted on
  each endpoint. These are software-derived routing facts; analog wiring
  and downstream supply topology still require board qualification.
properties:
  compatible:
    const: shanling,q2-audio
  audio-controller:
    $ref: /schemas/types.yaml#/definitions/phandle
    description: X2000 audio subsystem
  audio-codecs:
    $ref: /schemas/types.yaml#/definitions/phandle-array
    items:
      - description: CS43131 at address 0x30
        maxItems: 1
      - description: CS43131 at address 0x31
        maxItems: 1
      - description: CS43131 at address 0x32
        maxItems: 1
      - description: CS43131 at address 0x33
        maxItems: 1
    description: Four codec endpoints, in ascending I2C address order
  mute-gpios:
    maxItems: 1
    description: Board output mute, active high on PB10
  mode-gpios:
    maxItems: 1
    description: Board output mode, high for the stock headphone path on PB9
  boost-gpios:
    maxItems: 1
    description: Stock high-volume boost control on PB2; initially held low
required:
  - compatible
  - audio-controller
  - audio-codecs
  - mute-gpios
  - mode-gpios
  - boost-gpios
additionalProperties: false
```

## Documentation/devicetree/bindings/watchdog/ingenic,x2000-watchdog.yaml
```yaml
# SPDX-License-Identifier: (GPL-2.0-only OR BSD-2-Clause)
%YAML 1.2
---
$id: http://devicetree.org/schemas/watchdog/ingenic,x2000-watchdog.yaml#
$schema: http://devicetree.org/meta-schemas/core.yaml#

title: Ingenic X2000 TCU watchdog

maintainers:
  - linux-mips@vger.kernel.org

description: |
  The X2000 TCU watchdog has a 16-bit full counter compare and a separate
  half compare. This binding covers the watchdog register window only;
  OST clock events and PWM are separate X2000 blocks.

allOf:
  - $ref: watchdog.yaml#

properties:
  compatible:
    const: ingenic,x2000-watchdog
  reg:
    maxItems: 1
  clocks:
    items:
      - description: TCU module gate
      - description: Watchdog low-frequency mux selected by OPCR bit2
      - description: Always-available32768Hz diagnostic sleep source
  clock-names:
    items:
      - const: tcu
      - const: rtc
      - const: sleep

required:
  - compatible
  - reg
  - clocks
  - clock-names

unevaluatedProperties: false
```
